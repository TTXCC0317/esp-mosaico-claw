## components/region_service/Kconfig
```kconfig
menu "Region Service"

config REGION_SERVICE_GEOIP_URL
    string "GeoIP country lookup URL"
    default "https://gspe1-ssl.ls.apple.com/pep/gcc"
    help
        Endpoint returning the caller's ISO 3166 country code as plain text.
        The code is stored as the device region and shared by every service
        that depends on the serving area.

endmenu
```

## components/trial_provider/Kconfig
```kconfig
menu "Trial Provider"

config TRIAL_DEVICE_HMAC_KEY_ID
    int "eFuse HMAC key block"
    range 0 5
    default 0
    help
        eFuse HMAC key block used to sign Trial provider challenges.
        Board-specific configuration should override this value to match
        the production provisioning layout.

config TRIAL_SERVER_URL_CN
    string "Trial server URL for mainland China"
    default "https://mosaico-asr.espressif.com.cn"
    help
        HTTPS origin serving Trial authentication, chat and realtime ASR for
        devices located in mainland China.

config TRIAL_SERVER_URL_INTL
    string "Trial server URL outside mainland China"
    default "https://as.esp-claw.com"
    help
        HTTPS origin serving Trial authentication, chat and realtime ASR for
        devices located outside mainland China.

endmenu
```
